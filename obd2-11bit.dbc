VERSION ""

NS_ :

BS_:

BU_:

BO_ 2024 OBD2: 100 Vector__XXX
 SG_ S M : 7|8@0+ (1,0) [0|0] "" Vector__XXX
 SG_ S01PID m65M : 15|8@0+ (1,0) [0|255] "" Vector__XXX
 SG_ S01PID00_PIDsSupported_01_20 m0 : 23|32@0+ (1,0) [0|4294967295] "" Vector__XXX
 SG_ S01PID01_MonitorStatus m1 : 23|32@0+ (1,0) [0|4294967295] "" Vector__XXX
 SG_ S01PID02_FreezeDTC m2 : 23|16@0+ (1,0) [0|65535] "" Vector__XXX
 SG_ S01PID03_FuelSystemStatus m3 : 23|16@0+ (1,0) [0|65535] "" Vector__XXX
 SG_ S01PID04_CalcEngineLoad m4 : 23|8@0+ (0.39216,0) [0|100] "%" Vector__XXX
 SG_ S01PID05_EngineCoolantTemp m5 : 23|8@0+ (1,-40) [-40|215] "degC" Vector__XXX
 SG_ S01PID06_ShortFuelTrimBank1 m6 : 23|8@0+ (0.78125,-100) [-100|99.21875] "%" Vector__XXX
 SG_ S01PID07_LongFuelTrimBank1 m7 : 23|8@0+ (0.78125,-100) [-100|99.21875] "%" Vector__XXX
 SG_ S01PID08_ShortFuelTrimBank2 m8 : 23|8@0+ (0.78125,-100) [-100|99.21875] "%" Vector__XXX
 SG_ S01PID09_LongFuelTrimBank2 m9 : 23|8@0+ (0.78125,-100) [-100|99.21875] "%" Vector__XXX
 SG_ S01PID0A_FuelPressure m10 : 23|8@0+ (3,0) [0|765] "kPa" Vector__XXX
 SG_ S01PID0B_IntakeManiAbsPress m11 : 23|8@0+ (1,0) [0|255] "kPa" Vector__XXX
 SG_ S01PID0C_EngineRPM m12 : 23|16@0+ (0.25,0) [0|16383.75] "rpm" Vector__XXX
 SG_ S01PID0D_VehicleSpeed m13 : 23|8@0+ (1,0) [0|255] "km/h" Vector__XXX
 SG_ S01PID0E_TimingAdvance m14 : 23|8@0+ (0.5,-64) [-64|63.5] "deg before TDC" Vector__XXX
 SG_ S01PID0F_IntakeAirTemperature m15 : 23|8@0+ (1,-40) [-40|215] "degC" Vector__XXX
 SG_ S01PID10_MAFAirFlowRate m16 : 23|16@0+ (0.01,0) [0|655.35] "grams/sec" Vector__XXX
 SG_ S01PID11_ThrottlePosition m17 : 23|8@0+ (0.39216,0) [0|100] "%" Vector__XXX
 SG_ S01PID12_CmdSecAirStatus m18 : 23|8@0+ (1,0) [0|255] "" Vector__XXX
 SG_ S01PID14_OxySensor1_STFT m20 : 31|8@0+ (0.78125,-100) [-100|99.21875] "%" Vector__XXX
 SG_ S01PID14_OxySensor1_Volt m20 : 23|8@0+ (0.005,0) [0|1.275] "volts" Vector__XXX
 SG_ S01PID15_OxySensor2_STFT m21 : 31|8@0+ (0.78125,-100) [-100|99.21875] "%" Vector__XXX
 SG_ S01PID15_OxySensor2_Volt m21 : 23|8@0+ (0.005,0) [0|1.275] "volts" Vector__XXX
 SG_ S01PID16_OxySensor3_STFT m22 : 31|8@0+ (0.78125,-100) [-100|99.21875] "%" Vector__XXX
 SG_ S01PID16_OxySensor3_Volt m22 : 23|8@0+ (0.005,0) [0|1.275] "volts" Vector__XXX
 SG_ S01PID17_OxySensor4_STFT m23 : 31|8@0+ (0.78125,-100) [-100|99.21875] "%" Vector__XXX
 SG_ S01PID17_OxySensor4_Volt m23 : 23|8@0+ (0.005,0) [0|1.275] "volts" Vector__XXX
 SG_ S01PID18_OxySensor5_STFT m24 : 31|8@0+ (0.78125,-100) [-100|99.21875] "%" Vector__XXX
 SG_ S01PID18_OxySensor5_Volt m24 : 23|8@0+ (0.005,0) [0|1.275] "volts" Vector__XXX
 SG_ S01PID19_OxySensor6_STFT m25 : 31|8@0+ (0.78125,-100) [-100|99.21875] "%" Vector__XXX
 SG_ S01PID19_OxySensor6_Volt m25 : 23|8@0+ (0.005,0) [0|1.275] "volts" Vector__XXX
 SG_ S01PID1A_OxySensor7_STFT m26 : 31|8@0+ (0.78125,-100) [-100|99.21875] "%" Vector__XXX
 SG_ S01PID1A_OxySensor7_Volt m26 : 23|8@0+ (0.005,0) [0|1.275] "volts" Vector__XXX
 SG_ S01PID1B_OxySensor8_STFT m27 : 31|8@0+ (0.78125,-100) [-100|99.21875] "%" Vector__XXX
 SG_ S01PID1B_OxySensor8_Volt m27 : 23|8@0+ (0.005,0) [0|1.275] "volts" Vector__XXX
 SG_ S01PID1C_OBDStandard m28 : 23|8@0+ (1,0) [0|255] "" Vector__XXX
 SG_ S01PID1F_TimeSinceEngStart m31 : 23|16@0+ (1,0) [0|65535] "seconds" Vector__XXX
 SG_ S01PID20_PIDsSupported_21_40 m32 : 23|32@0+ (1,0) [0|4294967295] "" Vector__XXX
 SG_ S01PID21_DistanceMILOn m33 : 23|16@0+ (1,0) [0|65535] "km" Vector__XXX
 SG_ S01PID22_FuelRailPres m34 : 23|16@0+ (0.079,0) [0|5177.265] "kPa" Vector__XXX
 SG_ S01PID23_FuelRailGaug m35 : 23|16@0+ (10,0) [0|655350] "kPa" Vector__XXX
 SG_ S01PID24_OxySensor1_FAER m36 : 23|16@0+ (3.0517578125E-005,0) [0|2] "ratio" Vector__XXX
 SG_ S01PID24_OxySensor1_Volt m36 : 39|16@0+ (0.0001220703125,0) [0|2] "volts" Vector__XXX
 SG_ S01PID25_OxySensor2_FAER m37 : 23|16@0+ (3.0517578125E-005,0) [0|2] "ratio" Vector__XXX
 SG_ S01PID25_OxySensor2_Volt m37 : 39|16@0+ (0.0001220703125,0) [0|8] "volts" Vector__XXX
 SG_ S01PID26_OxySensor3_FAER m38 : 23|16@0+ (3.0517578125E-005,0) [0|2] "ratio" Vector__XXX
 SG_ S01PID26_OxySensor3_Volt m38 : 39|16@0+ (0.0001220703125,0) [0|8] "volts" Vector__XXX
 SG_ S01PID27_OxySensor4_FAER m39 : 23|16@0+ (3.0517578125E-005,0) [0|2] "ratio" Vector__XXX
 SG_ S01PID27_OxySensor4_Volt m39 : 39|16@0+ (0.0001220703125,0) [0|8] "volts" Vector__XXX
 SG_ S01PID28_OxySensor5_FAER m40 : 23|16@0+ (3.0517578125E-005,0) [0|2] "ratio" Vector__XXX
 SG_ S01PID28_OxySensor5_Volt m40 : 39|16@0+ (0.0001220703125,0) [0|8] "volts" Vector__XXX
 SG_ S01PID29_OxySensor6_FAER m41 : 23|16@0+ (3.0517578125E-005,0) [0|2] "ratio" Vector__XXX
 SG_ S01PID29_OxySensor6_Volt m41 : 39|16@0+ (0.0001220703125,0) [0|8] "volts" Vector__XXX
 SG_ S01PID2A_OxySensor7_FAER m42 : 23|16@0+ (3.0517578125E-005,0) [0|2] "ratio" Vector__XXX
 SG_ S01PID2A_OxySensor7_Volt m42 : 39|16@0+ (0.0001220703125,0) [0|8] "volts" Vector__XXX
 SG_ S01PID2B_OxySensor8_FAER m43 : 23|16@0+ (3.0517578125E-005,0) [0|2] "ratio" Vector__XXX
 SG_ S01PID2B_OxySensor8_Volt m43 : 39|16@0+ (0.0001220703125,0) [0|8] "volts" Vector__XXX
 SG_ S01PID2C_CmdEGR m44 : 23|8@0+ (0.392156862745098,0) [0|100] "%" Vector__XXX
 SG_ S01PID2D_EGRError m45 : 23|8@0+ (0.78125,-100) [-100|99.21875] "%" Vector__XXX
 SG_ S01PID2E_CmdEvapPurge m46 : 23|8@0+ (0.392156862745098,0) [0|100] "%" Vector__XXX
 SG_ S01PID2F_FuelTankLevel m47 : 23|8@0+ (0.392156862745098,0) [0|100] "%" Vector__XXX
 SG_ S01PID30_WaUpsSinceCodeClear m48 : 23|8@0+ (1,0) [0|255] "count" Vector__XXX
 SG_ S01PID31_DistSinceCodeClear m49 : 23|16@0+ (1,0) [0|65535] "km" Vector__XXX
 SG_ S01PID32_EvapSysVaporPres m50 : 23|16@0+ (0.25,0) [-8192|8191.75] "Pa" Vector__XXX
 SG_ S01PID33_AbsBaroPres m51 : 23|8@0+ (1,0) [0|255] "kPa" Vector__XXX
 SG_ S01PID34_OxySensor1_Crnt m52 : 39|16@0+ (0.00390625,-128) [-128|128] "mA" Vector__XXX
 SG_ S01PID34_OxySensor1_FAER m52 : 23|16@0+ (3.0517578125E-005,0) [0|2] "ratio" Vector__XXX
 SG_ S01PID35_OxySensor2_Crnt m53 : 39|16@0+ (0.00390625,-128) [-128|128] "mA" Vector__XXX
 SG_ S01PID35_OxySensor2_FAER m53 : 23|16@0+ (3.0517578125E-005,0) [0|2] "ratio" Vector__XXX
 SG_ S01PID36_OxySensor3_Crnt m54 : 39|16@0+ (0.00390625,-128) [-128|128] "mA" Vector__XXX
 SG_ S01PID36_OxySensor3_FAER m54 : 23|16@0+ (3.0517578125E-005,0) [0|2] "ratio" Vector__XXX
 SG_ S01PID37_OxySensor4_Crnt m55 : 39|16@0+ (0.00390625,-128) [-128|128] "mA" Vector__XXX
 SG_ S01PID37_OxySensor4_FAER m55 : 23|16@0+ (3.0517578125E-005,0) [0|2] "ratio" Vector__XXX
 SG_ S01PID38_OxySensor5_Crnt m56 : 39|16@0+ (0.00390625,-128) [-128|128] "mA" Vector__XXX
 SG_ S01PID38_OxySensor5_FAER m56 : 23|16@0+ (3.0517578125E-005,0) [0|2] "ratio" Vector__XXX
 SG_ S01PID39_OxySensor6_Crnt m57 : 39|16@0+ (0.00390625,-128) [-128|128] "mA" Vector__XXX
 SG_ S01PID39_OxySensor6_FAER m57 : 23|16@0+ (3.0517578125E-005,0) [0|2] "ratio" Vector__XXX
 SG_ S01PID3A_OxySensor7_Crnt m58 : 39|16@0+ (0.00390625,-128) [-128|128] "mA" Vector__XXX
 SG_ S01PID3A_OxySensor7_FAER m58 : 23|16@0+ (3.0517578125E-005,0) [0|2] "ratio" Vector__XXX
 SG_ S01PID3B_OxySensor8_Crnt m59 : 39|16@0+ (0.00390625,-128) [-128|128] "mA" Vector__XXX
 SG_ S01PID3B_OxySensor8_FAER m59 : 23|16@0+ (3.0517578125E-005,0) [0|2] "ratio" Vector__XXX
 SG_ S01PID3C_CatTempBank1Sens1 m60 : 23|16@0+ (0.1,-40) [-40|6513.5] "degC" Vector__XXX
 SG_ S01PID3D_CatTempBank2Sens1 m61 : 23|16@0+ (0.1,-40) [-40|6513.5] "degC" Vector__XXX
 SG_ S01PID3E_CatTempBank1Sens2 m62 : 23|16@0+ (0.1,-40) [-40|6513.5] "degC" Vector__XXX
 SG_ S01PID3F_CatTempBank2Sens2 m63 : 23|16@0+ (0.1,-40) [-40|6513.5] "degC" Vector__XXX
 SG_ S01PID40_PIDsSupported_41_60 m64 : 23|32@0+ (1,0) [0|4294967295] "" Vector__XXX
 SG_ S01PID41_MonStatusDriveCycle m65 : 23|32@0+ (1,0) [0|4294967295] "" Vector__XXX
 SG_ S01PID42_ControlModuleVolt m66 : 23|16@0+ (0.001,0) [0|65.535] "V" Vector__XXX
 SG_ S01PID43_AbsLoadValue m67 : 23|16@0+ (0.392156862745098,0) [0|25700] "%" Vector__XXX
 SG_ S01PID44_FuelAirCmdEquiv m68 : 23|16@0+ (3.0517578125E-005,0) [0|2] "ratio" Vector__XXX
 SG_ S01PID45_RelThrottlePos m69 : 23|8@0+ (0.392156862745098,0) [0|100] "%" Vector__XXX
 SG_ S01PID46_AmbientAirTemp m70 : 23|8@0+ (1,-40) [-40|215] "degC" Vector__XXX
 SG_ S01PID47_AbsThrottlePosB m71 : 23|8@0+ (0.392156862745098,0) [0|100] "%" Vector__XXX
 SG_ S01PID48_AbsThrottlePosC m72 : 23|8@0+ (0.392156862745098,0) [0|100] "%" Vector__XXX
 SG_ S01PID49_AbsThrottlePosD m73 : 23|8@0+ (0.392156862745098,0) [0|100] "%" Vector__XXX
 SG_ S01PID4A_AbsThrottlePosE m74 : 23|8@0+ (0.392156862745098,0) [0|100] "%" Vector__XXX
 SG_ S01PID4B_AbsThrottlePosF m75 : 23|8@0+ (0.392156862745098,0) [0|100] "%" Vector__XXX
 SG_ S01PID4C_CmdThrottleAct m76 : 23|8@0+ (0.392156862745098,0) [0|100] "%" Vector__XXX
 SG_ S01PID4D_TimeRunMILOn m77 : 23|16@0+ (1,0) [0|65535] "minutes" Vector__XXX
 SG_ S01PID4E_TimeSinceCodeClear m78 : 23|16@0+ (1,0) [0|65535] "minutes" Vector__XXX
 SG_ S01PID4F_Max_FAER m79 : 23|8@0+ (1,0) [0|255] "ratio" Vector__XXX
 SG_ S01PID4F_Max_IntManiAbsPres m79 : 47|8@0+ (10,0) [0|2550] "kPa" Vector__XXX
 SG_ S01PID4F_Max_OxySensCrnt m79 : 39|8@0+ (1,0) [0|255] "mA" Vector__XXX
 SG_ S01PID4F_Max_OxySensVol m79 : 31|8@0+ (1,0) [0|255] "V" Vector__XXX
 SG_ S01PID50_Max_AirFlowMAF m80 : 23|8@0+ (10,0) [0|2550] "g/s" Vector__XXX
 SG_ S01PID51_FuelType m81 : 23|8@0+ (1,0) [0|255] "" Vector__XXX
 SG_ S01PID52_EthanolFuelPct m82 : 23|8@0+ (0.392156862745098,0) [0|100] "%" Vector__XXX
 SG_ S01PID53_AbsEvapSysVapPres m83 : 23|16@0+ (0.005,0) [0|327.675] "kPa" Vector__XXX
 SG_ S01PID54_EvapSysVapPres m84 : 23|16@0+ (1,-32767) [-32767|32768] "Pa" Vector__XXX
 SG_ S01PID55_ShortSecOxyTrimBank1 m85 : 23|8@0+ (0.78125,-100) [-100|99.21875] "%" Vector__XXX
 SG_ S01PID55_ShortSecOxyTrimBank3 m85 : 31|8@0+ (0.78125,-100) [-100|99.21875] "%" Vector__XXX
 SG_ S01PID56_LongSecOxyTrimBank1 m86 : 23|8@0+ (0.78125,-100) [-100|99.21875] "%" Vector__XXX
 SG_ S01PID56_LongSecOxyTrimBank3 m86 : 31|8@0+ (0.78125,-100) [-100|99.21875] "%" Vector__XXX
 SG_ S01PID57_ShortSecOxyTrimBank2 m87 : 23|8@0+ (0.78125,-100) [-100|99.21875] "%" Vector__XXX
 SG_ S01PID57_ShortSecOxyTrimBank4 m87 : 31|8@0+ (0.78125,-100) [-100|99.21875] "%" Vector__XXX
 SG_ S01PID58_LongSecOxyTrimBank2 m88 : 23|8@0+ (0.78125,-100) [-100|99.21875] "%" Vector__XXX
 SG_ S01PID58_LongSecOxyTrimBank4 m88 : 31|8@0+ (0.78125,-100) [-100|99.21875] "%" Vector__XXX
 SG_ S01PID59_FuelRailAbsPres m89 : 23|16@0+ (10,0) [0|655350] "kPa" Vector__XXX
 SG_ S01PID5A_RelAccelPedalPos m90 : 23|8@0+ (0.392156862745098,0) [0|100] "%" Vector__XXX
 SG_ S01PID5B_HybrBatPackRemLife m91 : 23|8@0+ (0.392156862745098,0) [0|100] "%" Vector__XXX
 SG_ S01PID5C_EngineOilTemp m92 : 23|8@0+ (1,-40) [-40|215] "degC" Vector__XXX
 SG_ S01PID5D_FuelInjectionTiming m93 : 23|16@0+ (0.0078125,-210) [-210|301.9921875] "deg" Vector__XXX
 SG_ S01PID5E_EngineFuelRate m94 : 23|16@0+ (0.05,0) [0|3276.75] "L/h" Vector__XXX
 SG_ S01PID5F_EmissionReq m95 : 23|8@0+ (1,0) [0|255] "" Vector__XXX
 SG_ S01PID60_PIDsSupported_61_80 m96 : 23|32@0+ (1,0) [0|4294967295] "" Vector__XXX
 SG_ S01PID61_DemandEngTorqPct m97 : 23|8@0+ (1,-125) [-125|130] "%" Vector__XXX
 SG_ S01PID62_ActualEngTorqPct m98 : 23|8@0+ (1,-125) [-125|130] "%" Vector__XXX
 SG_ S01PID63_EngRefTorq m99 : 23|16@0+ (1,0) [0|65535] "Nm" Vector__XXX
 SG_ S01PID64_EngPctTorq_EP1 m100 : 31|8@0+ (1,-125) [-125|130] "%" Vector__XXX
 SG_ S01PID64_EngPctTorq_EP2 m100 : 39|8@0+ (1,-125) [-125|130] "%" Vector__XXX
 SG_ S01PID64_EngPctTorq_EP3 m100 : 47|8@0+ (1,-125) [-125|130] "%" Vector__XXX
 SG_ S01PID64_EngPctTorq_EP4 m100 : 55|8@0+ (1,-125) [-125|130] "%" Vector__XXX
 SG_ S01PID64_EngPctTorq_Idle m100 : 23|8@0+ (1,-125) [-125|130] "%" Vector__XXX
 SG_ S01PID65_AuxInputOutput m101 : 23|8@0+ (1,0) [0|255] "" Vector__XXX
 SG_ S01PID66_MAFSensor m102 : 23|8@0+ (1,0) [0|255] "" Vector__XXX
 SG_ S01PID67_EngineCoolantTemp m103 : 23|8@0+ (1,0) [0|255] "" Vector__XXX
 SG_ S01PID68_IntakeAirTempSens m104 : 23|8@0+ (1,0) [0|255] "" Vector__XXX
 SG_ S01PID69_CmdEGR_EGRError m105 : 23|8@0+ (1,0) [0|255] "" Vector__XXX
 SG_ S01PID6A_CmdDieselIntAir m106 : 23|8@0+ (1,0) [0|255] "" Vector__XXX
 SG_ S01PID6B_ExhaustGasTemp m107 : 23|8@0+ (1,0) [0|255] "" Vector__XXX
 SG_ S01PID6C_CmdThrottleActRel m108 : 23|8@0+ (1,0) [0|255] "" Vector__XXX
 SG_ S01PID6D_FuelPresContrSys m109 : 23|8@0+ (1,0) [0|255] "" Vector__XXX
 SG_ S01PID6E_InjPresContrSys m110 : 23|8@0+ (1,0) [0|255] "" Vector__XXX
 SG_ S01PID6F_TurboComprPres m111 : 23|8@0+ (1,0) [0|255] "" Vector__XXX
 SG_ S01PID70_BoostPresCntrl m112 : 23|8@0+ (1,0) [0|255] "" Vector__XXX
 SG_ S01PID78_Bank1EGT1 m120 : 31|16@0+ (0.1,-40) [-40|6513.5] "degC" Vector__XXX
 SG_ S01PID78_Bank1EGT2 m120 : 47|16@0+ (0.1,-40) [-40|6513.5] "degC" Vector__XXX
 SG_ S01PID78_Bank1EGT3 m120 : 63|16@0+ (0.1,-40) [-40|6513.5] "degC" Vector__XXX
 SG_ S01PID78_Bank1EGT4 m120 : 79|16@0+ (0.1,-40) [-40|6513.5] "degC" Vector__XXX
 SG_ S01PID79_Bank2EGT1 m121 : 31|16@0+ (0.1,-40) [-40|6513.5] "degC" Vector__XXX
 SG_ S01PID79_Bank2EGT2 m121 : 47|16@0+ (0.1,-40) [-40|6513.5] "degC" Vector__XXX
 SG_ S01PID79_Bank2EGT3 m121 : 63|16@0+ (0.1,-40) [-40|6513.5] "degC" Vector__XXX
 SG_ S01PID79_Bank2EGT4 m121 : 79|16@0+ (0.1,-40) [-40|6513.5] "degC" Vector__XXX
 SG_ S01PID80_PIDsSupported_81_A0 m128 : 23|32@0+ (1,0) [0|4294967295] "" Vector__XXX
 SG_ S01PID8E_EngFrictionPctTorq m142 : 23|8@0+ (1,-125) [-125|130] "%" Vector__XXX
 SG_ S01PIDA0_PIDsSupported_A1_C0 m160 : 23|32@0+ (1,0) [0|4294967295] "" Vector__XXX
 SG_ S01PIDA6_Odometer m166 : 23|32@0+ (0.1,0) [0|429496729.5] "km" Vector__XXX
 SG_ S01PIDC0_PIDsSupported_C1_E0 m192 : 23|32@0+ (1,0) [0|4294967295] "" Vector__XXX
 SG_ S02PID m66M : 15|8@0+ (1,0) [0|255] "" Vector__XXX
 SG_ S02PID02_FreezeDTC m2 : 23|16@0+ (1,0) [0|65535] "" Vector__XXX
 SG_ S09PID m73M : 15|8@0+ (1,0) [0|255] "" Vector__XXX
 SG_ S09PID02_VIN_ID m2 : 119|48@0+ (1,0) [0|0] "" Vector__XXX
 SG_ S09PID02_VIN_Model m2 : 55|40@0+ (1,0) [0|0] "" Vector__XXX
 SG_ S09PID02_VIN_Plant m2 : 111|8@0+ (1,0) [0|0] "" Vector__XXX
 SG_ S09PID02_VIN_SecurityDigit m2 : 95|8@0+ (1,0) [0|0] "" Vector__XXX
 SG_ S09PID02_VIN_WMI m2 : 31|24@0+ (1,0) [0|0] "" Vector__XXX
 SG_ S09PID02_VIN_Year m2 : 103|8@0+ (1,0) [0|0] "" Vector__XXX

CM_ BO_ 2024 "OBD";
BA_DEF_ SG_  "SignalIgnore" INT 0 1;
BA_DEF_ BO_  "VFrameFormat" ENUM  "StandardCAN","ExtendedCAN","StandardCAN_FD","ExtendedCAN_FD","J1939PG";
BA_DEF_ BO_  "TransportProtocolType" STRING ;
BA_DEF_  "BusType" STRING ;
BA_DEF_  "ProtocolType" STRING ;
BA_DEF_  "DatabaseCompiler" STRING ;
BA_DEF_DEF_  "SignalIgnore" 0;
BA_DEF_DEF_  "VFrameFormat" "";
BA_DEF_DEF_  "TransportProtocolType" "";
BA_DEF_DEF_  "BusType" "";
BA_DEF_DEF_  "ProtocolType" "";
BA_DEF_DEF_  "DatabaseCompiler" "CSS Electronics (wwww.csselectronics.com)";
BA_ "BusType" "CAN";
BA_ "ProtocolType" "OBD";
BA_ "VFrameFormat" BO_ 2024 0;
BA_ "SignalIgnore" SG_ 2024 S01PID 1;
BA_ "SignalIgnore" SG_ 2024 S02PID 1;
BA_ "SignalIgnore" SG_ 2024 S09PID 1;

BA_ "SignalIgnore" SG_ 2024 S 1;

BA_ "TransportProtocolType" BO_ 2024 "ISOTP";

SG_MUL_VAL_ 2024 S01PID S 65-65;
SG_MUL_VAL_ 2024 S01PID00_PIDsSupported_01_20 S01PID 0-0;
SG_MUL_VAL_ 2024 S01PID01_MonitorStatus S01PID 1-1;
SG_MUL_VAL_ 2024 S01PID02_FreezeDTC S01PID 2-2;
SG_MUL_VAL_ 2024 S01PID03_FuelSystemStatus S01PID 3-3;
SG_MUL_VAL_ 2024 S01PID04_CalcEngineLoad S01PID 4-4;
SG_MUL_VAL_ 2024 S01PID05_EngineCoolantTemp S01PID 5-5;
SG_MUL_VAL_ 2024 S01PID06_ShortFuelTrimBank1 S01PID 6-6;
SG_MUL_VAL_ 2024 S01PID07_LongFuelTrimBank1 S01PID 7-7;
SG_MUL_VAL_ 2024 S01PID08_ShortFuelTrimBank2 S01PID 8-8;
SG_MUL_VAL_ 2024 S01PID09_LongFuelTrimBank2 S01PID 9-9;
SG_MUL_VAL_ 2024 S01PID0A_FuelPressure S01PID 10-10;
SG_MUL_VAL_ 2024 S01PID0B_IntakeManiAbsPress S01PID 11-11;
SG_MUL_VAL_ 2024 S01PID0C_EngineRPM S01PID 12-12;
SG_MUL_VAL_ 2024 S01PID0D_VehicleSpeed S01PID 13-13;
SG_MUL_VAL_ 2024 S01PID0E_TimingAdvance S01PID 14-14;
SG_MUL_VAL_ 2024 S01PID0F_IntakeAirTemperature S01PID 15-15;
SG_MUL_VAL_ 2024 S01PID10_MAFAirFlowRate S01PID 16-16;
SG_MUL_VAL_ 2024 S01PID11_ThrottlePosition S01PID 17-17;
SG_MUL_VAL_ 2024 S01PID12_CmdSecAirStatus S01PID 18-18;
SG_MUL_VAL_ 2024 S01PID14_OxySensor1_STFT S01PID 20-20;
SG_MUL_VAL_ 2024 S01PID14_OxySensor1_Volt S01PID 20-20;
SG_MUL_VAL_ 2024 S01PID15_OxySensor2_STFT S01PID 21-21;
SG_MUL_VAL_ 2024 S01PID15_OxySensor2_Volt S01PID 21-21;
SG_MUL_VAL_ 2024 S01PID16_OxySensor3_STFT S01PID 22-22;
SG_MUL_VAL_ 2024 S01PID16_OxySensor3_Volt S01PID 22-22;
SG_MUL_VAL_ 2024 S01PID17_OxySensor4_STFT S01PID 23-23;
SG_MUL_VAL_ 2024 S01PID17_OxySensor4_Volt S01PID 23-23;
SG_MUL_VAL_ 2024 S01PID18_OxySensor5_STFT S01PID 24-24;
SG_MUL_VAL_ 2024 S01PID18_OxySensor5_Volt S01PID 24-24;
SG_MUL_VAL_ 2024 S01PID19_OxySensor6_STFT S01PID 25-25;
SG_MUL_VAL_ 2024 S01PID19_OxySensor6_Volt S01PID 25-25;
SG_MUL_VAL_ 2024 S01PID1A_OxySensor7_STFT S01PID 26-26;
SG_MUL_VAL_ 2024 S01PID1A_OxySensor7_Volt S01PID 26-26;
SG_MUL_VAL_ 2024 S01PID1B_OxySensor8_STFT S01PID 27-27;
SG_MUL_VAL_ 2024 S01PID1B_OxySensor8_Volt S01PID 27-27;
SG_MUL_VAL_ 2024 S01PID1C_OBDStandard S01PID 28-28;
SG_MUL_VAL_ 2024 S01PID1F_TimeSinceEngStart S01PID 31-31;
SG_MUL_VAL_ 2024 S01PID20_PIDsSupported_21_40 S01PID 32-32;
SG_MUL_VAL_ 2024 S01PID21_DistanceMILOn S01PID 33-33;
SG_MUL_VAL_ 2024 S01PID22_FuelRailPres S01PID 34-34;
SG_MUL_VAL_ 2024 S01PID23_FuelRailGaug S01PID 35-35;
SG_MUL_VAL_ 2024 S01PID24_OxySensor1_FAER S01PID 36-36;
SG_MUL_VAL_ 2024 S01PID24_OxySensor1_Volt S01PID 36-36;
SG_MUL_VAL_ 2024 S01PID25_OxySensor2_FAER S01PID 37-37;
SG_MUL_VAL_ 2024 S01PID25_OxySensor2_Volt S01PID 37-37;
SG_MUL_VAL_ 2024 S01PID26_OxySensor3_FAER S01PID 38-38;
SG_MUL_VAL_ 2024 S01PID26_OxySensor3_Volt S01PID 38-38;
SG_MUL_VAL_ 2024 S01PID27_OxySensor4_FAER S01PID 39-39;
SG_MUL_VAL_ 2024 S01PID27_OxySensor4_Volt S01PID 39-39;
SG_MUL_VAL_ 2024 S01PID28_OxySensor5_FAER S01PID 40-40;
SG_MUL_VAL_ 2024 S01PID28_OxySensor5_Volt S01PID 40-40;
SG_MUL_VAL_ 2024 S01PID29_OxySensor6_FAER S01PID 41-41;
SG_MUL_VAL_ 2024 S01PID29_OxySensor6_Volt S01PID 41-41;
SG_MUL_VAL_ 2024 S01PID2A_OxySensor7_FAER S01PID 42-42;
SG_MUL_VAL_ 2024 S01PID2A_OxySensor7_Volt S01PID 42-42;
SG_MUL_VAL_ 2024 S01PID2B_OxySensor8_FAER S01PID 43-43;
SG_MUL_VAL_ 2024 S01PID2B_OxySensor8_Volt S01PID 43-43;
SG_MUL_VAL_ 2024 S01PID2C_CmdEGR S01PID 44-44;
SG_MUL_VAL_ 2024 S01PID2D_EGRError S01PID 45-45;
SG_MUL_VAL_ 2024 S01PID2E_CmdEvapPurge S01PID 46-46;
SG_MUL_VAL_ 2024 S01PID2F_FuelTankLevel S01PID 47-47;
SG_MUL_VAL_ 2024 S01PID30_WaUpsSinceCodeClear S01PID 48-48;
SG_MUL_VAL_ 2024 S01PID31_DistSinceCodeClear S01PID 49-49;
SG_MUL_VAL_ 2024 S01PID32_EvapSysVaporPres S01PID 50-50;
SG_MUL_VAL_ 2024 S01PID33_AbsBaroPres S01PID 51-51;
SG_MUL_VAL_ 2024 S01PID34_OxySensor1_Crnt S01PID 52-52;
SG_MUL_VAL_ 2024 S01PID34_OxySensor1_FAER S01PID 52-52;
SG_MUL_VAL_ 2024 S01PID35_OxySensor2_Crnt S01PID 53-53;
SG_MUL_VAL_ 2024 S01PID35_OxySensor2_FAER S01PID 53-53;
SG_MUL_VAL_ 2024 S01PID36_OxySensor3_Crnt S01PID 54-54;
SG_MUL_VAL_ 2024 S01PID36_OxySensor3_FAER S01PID 54-54;
SG_MUL_VAL_ 2024 S01PID37_OxySensor4_Crnt S01PID 55-55;
SG_MUL_VAL_ 2024 S01PID37_OxySensor4_FAER S01PID 55-55;
SG_MUL_VAL_ 2024 S01PID38_OxySensor5_Crnt S01PID 56-56;
SG_MUL_VAL_ 2024 S01PID38_OxySensor5_FAER S01PID 56-56;
SG_MUL_VAL_ 2024 S01PID39_OxySensor6_Crnt S01PID 57-57;
SG_MUL_VAL_ 2024 S01PID39_OxySensor6_FAER S01PID 57-57;
SG_MUL_VAL_ 2024 S01PID3A_OxySensor7_Crnt S01PID 58-58;
SG_MUL_VAL_ 2024 S01PID3A_OxySensor7_FAER S01PID 58-58;
SG_MUL_VAL_ 2024 S01PID3B_OxySensor8_Crnt S01PID 59-59;
SG_MUL_VAL_ 2024 S01PID3B_OxySensor8_FAER S01PID 59-59;
SG_MUL_VAL_ 2024 S01PID3C_CatTempBank1Sens1 S01PID 60-60;
SG_MUL_VAL_ 2024 S01PID3D_CatTempBank2Sens1 S01PID 61-61;
SG_MUL_VAL_ 2024 S01PID3E_CatTempBank1Sens2 S01PID 62-62;
SG_MUL_VAL_ 2024 S01PID3F_CatTempBank2Sens2 S01PID 63-63;
SG_MUL_VAL_ 2024 S01PID40_PIDsSupported_41_60 S01PID 64-64;
SG_MUL_VAL_ 2024 S01PID41_MonStatusDriveCycle S01PID 65-65;
SG_MUL_VAL_ 2024 S01PID42_ControlModuleVolt S01PID 66-66;
SG_MUL_VAL_ 2024 S01PID43_AbsLoadValue S01PID 67-67;
SG_MUL_VAL_ 2024 S01PID44_FuelAirCmdEquiv S01PID 68-68;
SG_MUL_VAL_ 2024 S01PID45_RelThrottlePos S01PID 69-69;
SG_MUL_VAL_ 2024 S01PID46_AmbientAirTemp S01PID 70-70;
SG_MUL_VAL_ 2024 S01PID47_AbsThrottlePosB S01PID 71-71;
SG_MUL_VAL_ 2024 S01PID48_AbsThrottlePosC S01PID 72-72;
SG_MUL_VAL_ 2024 S01PID49_AbsThrottlePosD S01PID 73-73;
SG_MUL_VAL_ 2024 S01PID4A_AbsThrottlePosE S01PID 74-74;
SG_MUL_VAL_ 2024 S01PID4B_AbsThrottlePosF S01PID 75-75;
SG_MUL_VAL_ 2024 S01PID4C_CmdThrottleAct S01PID 76-76;
SG_MUL_VAL_ 2024 S01PID4D_TimeRunMILOn S01PID 77-77;
SG_MUL_VAL_ 2024 S01PID4E_TimeSinceCodeClear S01PID 78-78;
SG_MUL_VAL_ 2024 S01PID4F_Max_FAER S01PID 79-79;
SG_MUL_VAL_ 2024 S01PID4F_Max_IntManiAbsPres S01PID 79-79;
SG_MUL_VAL_ 2024 S01PID4F_Max_OxySensCrnt S01PID 79-79;
SG_MUL_VAL_ 2024 S01PID4F_Max_OxySensVol S01PID 79-79;
SG_MUL_VAL_ 2024 S01PID50_Max_AirFlowMAF S01PID 80-80;
SG_MUL_VAL_ 2024 S01PID51_FuelType S01PID 81-81;
SG_MUL_VAL_ 2024 S01PID52_EthanolFuelPct S01PID 82-82;
SG_MUL_VAL_ 2024 S01PID53_AbsEvapSysVapPres S01PID 83-83;
SG_MUL_VAL_ 2024 S01PID54_EvapSysVapPres S01PID 84-84;
SG_MUL_VAL_ 2024 S01PID55_ShortSecOxyTrimBank1 S01PID 85-85;
SG_MUL_VAL_ 2024 S01PID55_ShortSecOxyTrimBank3 S01PID 85-85;
SG_MUL_VAL_ 2024 S01PID56_LongSecOxyTrimBank1 S01PID 86-86;
SG_MUL_VAL_ 2024 S01PID56_LongSecOxyTrimBank3 S01PID 86-86;
SG_MUL_VAL_ 2024 S01PID57_ShortSecOxyTrimBank2 S01PID 87-87;
SG_MUL_VAL_ 2024 S01PID57_ShortSecOxyTrimBank4 S01PID 87-87;
SG_MUL_VAL_ 2024 S01PID58_LongSecOxyTrimBank2 S01PID 88-88;
SG_MUL_VAL_ 2024 S01PID58_LongSecOxyTrimBank4 S01PID 88-88;
SG_MUL_VAL_ 2024 S01PID59_FuelRailAbsPres S01PID 89-89;
SG_MUL_VAL_ 2024 S01PID5A_RelAccelPedalPos S01PID 90-90;
SG_MUL_VAL_ 2024 S01PID5B_HybrBatPackRemLife S01PID 91-91;
SG_MUL_VAL_ 2024 S01PID5C_EngineOilTemp S01PID 92-92;
SG_MUL_VAL_ 2024 S01PID5D_FuelInjectionTiming S01PID 93-93;
SG_MUL_VAL_ 2024 S01PID5E_EngineFuelRate S01PID 94-94;
SG_MUL_VAL_ 2024 S01PID5F_EmissionReq S01PID 95-95;
SG_MUL_VAL_ 2024 S01PID60_PIDsSupported_61_80 S01PID 96-96;
SG_MUL_VAL_ 2024 S01PID61_DemandEngTorqPct S01PID 97-97;
SG_MUL_VAL_ 2024 S01PID62_ActualEngTorqPct S01PID 98-98;
SG_MUL_VAL_ 2024 S01PID63_EngRefTorq S01PID 99-99;
SG_MUL_VAL_ 2024 S01PID64_EngPctTorq_EP1 S01PID 100-100;
SG_MUL_VAL_ 2024 S01PID64_EngPctTorq_EP2 S01PID 100-100;
SG_MUL_VAL_ 2024 S01PID64_EngPctTorq_EP3 S01PID 100-100;
SG_MUL_VAL_ 2024 S01PID64_EngPctTorq_EP4 S01PID 100-100;
SG_MUL_VAL_ 2024 S01PID64_EngPctTorq_Idle S01PID 100-100;
SG_MUL_VAL_ 2024 S01PID65_AuxInputOutput S01PID 101-101;
SG_MUL_VAL_ 2024 S01PID66_MAFSensor S01PID 102-102;
SG_MUL_VAL_ 2024 S01PID67_EngineCoolantTemp S01PID 103-103;
SG_MUL_VAL_ 2024 S01PID68_IntakeAirTempSens S01PID 104-104;
SG_MUL_VAL_ 2024 S01PID69_CmdEGR_EGRError S01PID 105-105;
SG_MUL_VAL_ 2024 S01PID6A_CmdDieselIntAir S01PID 106-106;
SG_MUL_VAL_ 2024 S01PID6B_ExhaustGasTemp S01PID 107-107;
SG_MUL_VAL_ 2024 S01PID6C_CmdThrottleActRel S01PID 108-108;
SG_MUL_VAL_ 2024 S01PID6D_FuelPresContrSys S01PID 109-109;
SG_MUL_VAL_ 2024 S01PID6E_InjPresContrSys S01PID 110-110;
SG_MUL_VAL_ 2024 S01PID6F_TurboComprPres S01PID 111-111;
SG_MUL_VAL_ 2024 S01PID70_BoostPresCntrl S01PID 112-112;
SG_MUL_VAL_ 2024 S01PID78_Bank1EGT1 S01PID 120-120;
SG_MUL_VAL_ 2024 S01PID78_Bank1EGT2 S01PID 120-120;
SG_MUL_VAL_ 2024 S01PID78_Bank1EGT3 S01PID 120-120;
SG_MUL_VAL_ 2024 S01PID78_Bank1EGT4 S01PID 120-120;
SG_MUL_VAL_ 2024 S01PID79_Bank2EGT1 S01PID 121-121;
SG_MUL_VAL_ 2024 S01PID79_Bank2EGT2 S01PID 121-121;
SG_MUL_VAL_ 2024 S01PID79_Bank2EGT3 S01PID 121-121;
SG_MUL_VAL_ 2024 S01PID79_Bank2EGT4 S01PID 121-121;
SG_MUL_VAL_ 2024 S01PID80_PIDsSupported_81_A0 S01PID 128-128;
SG_MUL_VAL_ 2024 S01PID8E_EngFrictionPctTorq S01PID 142-142;
SG_MUL_VAL_ 2024 S01PIDA0_PIDsSupported_A1_C0 S01PID 160-160;
SG_MUL_VAL_ 2024 S01PIDA6_Odometer S01PID 166-166;
SG_MUL_VAL_ 2024 S01PIDC0_PIDsSupported_C1_E0 S01PID 192-192;
SG_MUL_VAL_ 2024 S02PID S 66-66;
SG_MUL_VAL_ 2024 S02PID02_FreezeDTC S02PID 2-2;
SG_MUL_VAL_ 2024 S09PID S 73-73;
SG_MUL_VAL_ 2024 S09PID02_VIN_ID S09PID 2-2;
SG_MUL_VAL_ 2024 S09PID02_VIN_Model S09PID 2-2;
SG_MUL_VAL_ 2024 S09PID02_VIN_Plant S09PID 2-2;
SG_MUL_VAL_ 2024 S09PID02_VIN_SecurityDigit S09PID 2-2;
SG_MUL_VAL_ 2024 S09PID02_VIN_WMI S09PID 2-2;
SG_MUL_VAL_ 2024 S09PID02_VIN_Year S09PID 2-2;
